## board/hc250/packages/brcmfmac-bcm4319/Config.in
```kconfig
config BR2_PACKAGE_BRCMFMAC_BCM4319
	bool "brcmfmac with BCM4319 support (out of tree)"
	depends on BR2_LINUX_KERNEL
	help
	  The kernel's own brcmfmac, built out of tree with the BCM4319
	  (an older Sonics-backplane SDIO chip) added: its SDIO id, its
	  firmware name and a generic SB core scan. Replaces the in-tree
	  brcmfmac module. The firmware is not shipped; the board copies
	  it off its own stock partition.

comment "brcmfmac-bcm4319 needs a Linux kernel"
	depends on !BR2_LINUX_KERNEL
```

## board/hc800/packages/hc800-acpi/Config.in
```kconfig
config BR2_PACKAGE_HC800_ACPI
	bool "hc800-acpi (ACPI table upgrade: the IO microcontroller)"
	depends on BR2_i386 || BR2_x86_64
	help
	  Compiles the HC-800's own ACPI tables (board/hc800/acpi/*.asl)
	  with the host iasl and packs them as an uncompressed cpio under
	  kernel/firmware/acpi/, which post-image.sh puts in front of the
	  initrd. The kernel loads them early as an ACPI table upgrade
	  (CONFIG_ACPI_TABLE_UPGRADE).

	  Today that is one SSDT: the LM3S1162 IO microcontroller as a
	  serdev child of the BIOS's ttyS3, so gpio-ohc-iomcu binds it at
	  boot with no userspace attach.
```

## board/hc800/packages/ths8200/Config.in
```kconfig
config BR2_PACKAGE_THS8200
	bool "ths8200 (component video output)"
	depends on BR2_PACKAGE_HAS_UDEV || !BR2_PACKAGE_HAS_UDEV
	help
	  Configure the TI THS8200 video DAC over i2c-dev, from a register
	  file captured off working hardware.

	  This is the HC-800's only proven video output. The ADV7511 HDMI
	  transmitter on the same bus is fitted and answers, but nothing
	  configures it even under the vendor OS, so component is what
	  actually produces a picture.

	  Needs CONFIG_I2C_CHARDEV and CONFIG_I2C_I801 in the kernel.
```

## packages/alsa-ohceq/Config.in
```kconfig
config BR2_PACKAGE_ALSA_OHCEQ
	bool "alsa-ohceq (per-output tone: bass, treble, balance)"
	depends on BR2_PACKAGE_ALSA_LIB
	select BR2_PACKAGE_ALSA_LIB_PCM
	help
	  openHC's tone stage, an ALSA filter plugin (pcm type "ohceq"):
	  shelving bass and treble and left/right balance on 16-bit
	  stereo, controlled live through mixer controls it creates on
	  the card, the way softvol does. ohc-audiod puts one in front
	  of every output and drives those controls.
```

## packages/em357-ncp-firmware/Config.in
```kconfig
config BR2_PACKAGE_EM357_NCP_FIRMWARE
	bool "em357-ncp-firmware"
	help
	  EmberZNet 6.7.8 NCP image for the on-board EM357 Zigbee
	  radio (UART, software flow control). ohc-zigbee flashes it at
	  boot when the radio runs an older EmberZNet, the way Control4
	  reflashes it from its own images. Selected by the zigbee
	  feature.
```

## packages/iomcu-attach/Config.in
```kconfig
config BR2_PACKAGE_IOMCU_ATTACH
	bool "iomcu-attach (IO microcontroller line discipline)"
	help
	  Hands a UART to the gpio-ohc-iomcu line discipline, which is what
	  turns the IO microcontroller's relays and contacts into a standard
	  gpiochip.

	  Only for a board whose device tree does not describe the part (the
	  HC-800 has no tree at all); where a "control4,io-mcu" node exists the
	  kernel binds it as a serdev device and this is never run. Without a
	  node serdev has nothing to bind to, so the attachment has to come
	  from userspace. This sets the line speed and issues TIOCSETD,
	  then holds the descriptor — a line discipline lasts only as long as
	  the fd that set it.

	  util-linux's ldattach does the same job, but only comes with
	  BR2_PACKAGE_UTIL_LINUX_BINARIES and its fifty-odd other tools.
```

## packages/librespot/Config.in
```kconfig
config BR2_PACKAGE_LIBRESPOT
	bool "librespot"
	depends on BR2_PACKAGE_HOST_RUSTC_TARGET_ARCH_SUPPORTS
	depends on BR2_TOOLCHAIN_HAS_THREADS
	depends on !BR2_STATIC_LIBS
	select BR2_PACKAGE_HOST_RUSTC
	select BR2_PACKAGE_ALSA_LIB
	select BR2_PACKAGE_ALSA_LIB_PCM
	help
	  An open source client library for Spotify, which makes the box
	  appear as a Spotify Connect device. Requires a Spotify Premium
	  account at runtime.

	  Not packaged by Buildroot; this is openHC's own package.

	  https://github.com/librespot-org/librespot

comment "librespot needs a toolchain w/ threads, dynamic library"
	depends on BR2_PACKAGE_HOST_RUSTC_TARGET_ARCH_SUPPORTS
	depends on !BR2_TOOLCHAIN_HAS_THREADS || BR2_STATIC_LIBS
```

## packages/ohc-motd/Config.in
```kconfig
config BR2_PACKAGE_OHC_MOTD
	bool "ohc-motd (figlet-generated /etc/motd)"
	default y
	help
	  Generate /etc/motd from `figlet -f slant openHC` at build time,
	  so the banner is real figlet output rather than a checked-in blob.
	  figlet must be present in the build environment (build/Dockerfile).
```

## packages/ohc-nqptp/Config.in
```kconfig
config BR2_PACKAGE_OHC_NQPTP
	bool "nqptp (openHC, multi-instance)"
	depends on BR2_USE_MMU # fork()
	depends on BR2_TOOLCHAIN_HAS_THREADS
	help
	  The PTP timing companion AirPlay 2 needs. One per host, shared
	  by every shairport-sync instance; this build is nqptp's
	  development branch, which serves several instances (each with
	  its own shared-memory interface) where the 1.2.x releases serve
	  one. Started by ohc-audiod (or S99shairport-sync), not by an
	  init script of its own.

	  https://github.com/mikebrady/nqptp
```

## packages/ohc-shairport-sync/Config.in
```kconfig
config BR2_PACKAGE_OHC_SHAIRPORT_SYNC
	bool "shairport-sync (openHC, AirPlay 2, multi-instance)"
	depends on BR2_TOOLCHAIN_HAS_THREADS_NPTL
	depends on BR2_INSTALL_LIBSTDCPP
	depends on BR2_USE_WCHAR # libglib2
	depends on BR2_USE_MMU
	depends on BR2_PACKAGE_LIBGPG_ERROR_ARCH_SUPPORTS # libgcrypt
	depends on BR2_PACKAGE_FFMPEG_ARCH_SUPPORTS
	depends on !BR2_PACKAGE_SHAIRPORT_SYNC # same binary, same paths
	select BR2_PACKAGE_ALSA_LIB
	select BR2_PACKAGE_ALSA_LIB_MIXER
	select BR2_PACKAGE_LIBCONFIG
	select BR2_PACKAGE_POPT
	select BR2_PACKAGE_OPENSSL
	select BR2_PACKAGE_AVAHI
	select BR2_PACKAGE_AVAHI_DAEMON
	select BR2_PACKAGE_DBUS
	select BR2_PACKAGE_LIBGLIB2
	select BR2_PACKAGE_LIBPLIST
	select BR2_PACKAGE_LIBSODIUM
	select BR2_PACKAGE_LIBGCRYPT
	select BR2_PACKAGE_FFMPEG
	select BR2_PACKAGE_UTIL_LINUX
	select BR2_PACKAGE_UTIL_LINUX_LIBUUID
	select BR2_PACKAGE_OHC_NQPTP # runtime
	help
	  An AirPlay 2 receiver (it also takes classic AirPlay senders),
	  built from shairport-sync's development branch: that is where
	  several AirPlay 2 instances can share one host and one address,
	  each on its own port (shairport-sync#2277, #2273, #2278, #2287).
	  audiod runs one per AirPlay endpoint. Built with the D-Bus
	  remote control (how audiod moves a sender's volume slider)
	  and the metadata pipe (now-playing and cover art).

	  https://github.com/mikebrady/shairport-sync
```

## packages/webview/Config.in
```kconfig
config BR2_PACKAGE_WEBVIEW
	bool "webview"
	depends on BR2_PACKAGE_WPEWEBKIT
	select BR2_PACKAGE_LIBXKBCOMMON
	select BR2_PACKAGE_XKEYBOARD_CONFIG # runtime, keymaps
	help
	  Full-screen web surface for openHC.

	  Creates one WPE WebKit view, loads a URL and runs a main loop. No
	  chrome, no navigation, no tabs -- the display path lives entirely in
	  the libwpe backend, so this is only the part WPE does not ship
	  (Buildroot builds WebKit with ENABLE_MINIBROWSER=OFF).

	  The URL comes from argv[1] or $WEBVIEW_URL, defaulting to
	  http://localhost/ -- the dashboard webd already serves on :80.
	  What any other URL serves is not openHC's concern.

	  USB keyboards and mice drive the page: through libinput on WPE
	  Platform's DRM display, and on the libwpe path by reading
	  /dev/input directly (keymaps from xkeyboard-config). The page
	  draws the mouse cursor itself.

comment "webview needs wpewebkit"
	depends on !BR2_PACKAGE_WPEWEBKIT
```
