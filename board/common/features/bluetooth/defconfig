## board/ea/common/kernel/drivers/gpu/drm/ce5300/Kconfig
```kconfig
# SPDX-License-Identifier: GPL-2.0-only
config DRM_CE5300
	tristate "Intel Atom CE5300 display controller (VDC + HDMI)"
	depends on DRM && PCI && X86 && OF && I2C
	select APERTURE_HELPERS
	select DRM_BRIDGE
	select DRM_BRIDGE_CONNECTOR
	select DRM_CLIENT_SELECTION
	select DRM_DISPLAY_HELPER
	select DRM_GEM_DMA_HELPER
	select DRM_KMS_HELPER
	select IOSF_MBI
	help
	  KMS driver for the display controller of the Intel Atom CE5300
	  media SoC (PCI 8086:2e61) and its HDMI transmitter (PCI 8086:2e63),
	  a DRM bridge whose audio is a child device for the ALSA driver.
	  It takes over the mode the firmware set up.
```

## board/ea/common/packages/powervr-sgx-firmware/Config.in
```kconfig
config BR2_PACKAGE_POWERVR_SGX_FIRMWARE
	bool "powervr-sgx-firmware"
	depends on BR2_i386 || BR2_x86_64
	help
	  The open SGX545 microkernel (MIT) that the powervr_sgx kernel
	  driver loads at probe: /lib/firmware/powervr_sgx/sgx545_ukernel.bin,
	  from the powervr_sgx release that matches the submodule.

	  https://github.com/The1TrueJoe/powervr_sgx
```

## packages/sendspin-cpp-cli/Config.in
```kconfig
config BR2_PACKAGE_SENDSPIN_CPP_CLI
	bool "sendspin-cpp-cli"
	depends on BR2_INSTALL_LIBSTDCPP
	depends on BR2_TOOLCHAIN_GCC_AT_LEAST_10 # C++20
	depends on BR2_TOOLCHAIN_HAS_THREADS
	depends on BR2_USE_MMU # fork()
	select BR2_PACKAGE_ALSA_LIB
	select BR2_PACKAGE_ALSA_LIB_PCM
	select BR2_PACKAGE_ALSA_LIB_MIXER
	help
	  A headless Sendspin player (sendspin-cli): a Sendspin server
	  (Music Assistant, for one) finds it over mDNS and plays to it,
	  in sync with its other players. audiod runs one per Sendspin
	  endpoint. mDNS needs Avahi's libdns_sd compatibility library
	  (BR2_PACKAGE_AVAHI_LIBDNSSD_COMPATIBILITY); without it the
	  player cannot be discovered.

	  Not packaged by Buildroot; this is openHC's own package.

	  https://github.com/Sendspin/sendspin-cpp-cli

comment "sendspin-cpp-cli needs a toolchain w/ C++, threads, gcc >= 10"
	depends on BR2_USE_MMU
	depends on !BR2_INSTALL_LIBSTDCPP || !BR2_TOOLCHAIN_HAS_THREADS || \
		!BR2_TOOLCHAIN_GCC_AT_LEAST_10
```

## packages/webview/Config.in
```kconfig
config BR2_PACKAGE_WEBVIEW
	bool "webview"
	depends on BR2_PACKAGE_WPEWEBKIT_WPE_PLATFORM_DRM
	help
	  Full-screen web surface for openHC.

	  Creates one WPE WebKit view on the WPE Platform DRM display,
	  loads a URL and runs a main loop. No chrome, no navigation, no
	  tabs (Buildroot builds WebKit with ENABLE_MINIBROWSER=OFF).
	  S95ohc-display runs it when the web UI turns the view on.

	  The URL comes from argv[1] or $WEBVIEW_URL, defaulting to
	  http://localhost/ -- the dashboard webd already serves on :80.

	  USB keyboards and mice drive the page through libinput. The
	  page draws the mouse cursor itself.

comment "webview needs wpewebkit with the WPE Platform DRM display"
	depends on !BR2_PACKAGE_WPEWEBKIT_WPE_PLATFORM_DRM
```

## packages/zwave-js-config/Config.in
```kconfig
config BR2_PACKAGE_ZWAVE_JS_CONFIG
	bool "zwave-js-config"
	help
	  Z-Wave JS's device database (@zwave-js/config's device files),
	  which zwave-bridge reads to name each node and its
	  configuration parameters. Data only.

	  https://github.com/zwave-js/zwave-js
```
