## board/ea/common/firmware/dsp/adau1451/Config.in
```kconfig
config BR2_PACKAGE_ADAU1451_FW
	bool "adau1451-fw (EA3 DSP firmware)"
	help
	  openHC's SigmaDSP firmware file for the EA3's ADAU1451, built
	  from board/ea/common/firmware/dsp/adau1451/ea3.json: the filter
	  tables behind every tone and EQ knob, the controls ALSA shows
	  for them, and the DSP's boot settings, all for stock's program.
	  Installed as /lib/firmware/openhc/adau1451-ea3.bin, which the
	  board's device tree names and the adau1451-c4 codec driver
	  loads through the kernel's sigmadsp core. With a program
	  (below), also a file for openHC's own.

	  Selected by the audio-dsp feature.

config BR2_PACKAGE_ADAU1451_FW_PROGRAM
	string "DSP program"
	depends on BR2_PACKAGE_ADAU1451_FW
	help
	  Folder holding openHC's DSP program as export2program.py
	  writes it: program.txt (memory blocks from a SigmaStudio+
	  export) and params.json (its parameter map). CI builds it in
	  the same run as the image (build.sh takes it from
	  OHC_DSP_PROGRAM); it is never committed. Set, the build also
	  makes /lib/firmware/openhc/adau1451-ea3-openhc.bin from
	  ea3-openhc.json: register init, program and cells. Empty: only
	  adau1451-ea3.bin, the parameters of stock's program.
```

## board/ea/common/packages/sgx545-srvinit/Config.in
```kconfig
config BR2_PACKAGE_SGX545_SRVINIT
	bool "sgx545-srvinit (open SGX545 GPU bring-up)"
	depends on BR2_x86_64
	help
	  srvinit, from the sgx545-ce submodule: brings the PowerVR SGX545
	  in the Intel Atom CE5300 up once at boot without the DDK's
	  libsrv_init. It loads the USSE microkernel, assembles the PDS
	  programs that start it and hands everything to the in-tree
	  sgx545-ce kernel driver (CONFIG_SGX545_CE). Native x86_64.

	  The microkernel is the one piece of Imagination's code it needs.
	  It is not in either repository: the build extracts it from
	  Intel's Cedarview DDK 1.7.862890 tarball (the same download
	  sgx545-um uses) into /lib/firmware.

	  https://github.com/The1TrueJoe/sgx545-ce
```
