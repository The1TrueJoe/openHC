// SPDX-License-Identifier: GPL-2.0
/* AR9485 Wi-Fi (the `wifi` feature). High is the radio's ENABLED state. */
#define EA_LINE_27	"wlan_disable"

&gpio {
	wlan-disable-hog {
		gpio-hog;
		gpios = <27 GPIO_ACTIVE_HIGH>;
		output-high;
		line-name = "wlan_disable";
	};
};
