// SPDX-License-Identifier: GPL-2.0
/*
 * Control4 EA-1 v2: Wi-Fi, no switch, no DSP.
 * Includes mirror board/ea/ea1-v2/ohc.features: keep them in step.
 */
/dts-v1/;

#include "ea.dtsi"

/ {
	model = "Control4 EA-1 v2";
	compatible = "control4,ea1-v2", "intel,ce5300";
};
