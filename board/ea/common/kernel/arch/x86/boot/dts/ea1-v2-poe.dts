// SPDX-License-Identifier: GPL-2.0
/*
 * Control4 EA-1 v2 PoE: PoE, BCM53125 switch.
 * Includes mirror board/ea/ea1-v2-poe/ohc.features: keep them in step.
 */
/dts-v1/;

#include "ea.dtsi"
#include "ea-switch.dtsi"

/ {
	model = "Control4 EA-1 v2 PoE";
	compatible = "control4,ea1-v2-poe", "intel,ce5300";
};
