// SPDX-License-Identifier: GPL-2.0
/*
 * Control4 EA-3 v2: wired-only, BCM53125 switch, ADAU1451 DSP.
 * Includes mirror board/ea/ea3-v2/ohc.features: keep them in step.
 */
/dts-v1/;

#include "ea3.dtsi"
#include "ea-switch.dtsi"
#include "ea-audio-dsp.dtsi"

/ {
	model = "Control4 EA-3 v2";
	compatible = "control4,ea3-v2", "intel,ce5300";
};
