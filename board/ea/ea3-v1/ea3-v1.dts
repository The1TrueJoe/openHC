// SPDX-License-Identifier: GPL-2.0
/*
 * Control4 EA-3 v1: Wi-Fi, BCM53125 switch, ADAU1451 DSP.
 * Lives with the board; the .dtsi files are shared, in
 * board/ea/common/kernel/arch/x86/boot/dts/. The includes mirror
 * board/ea/ea3-v1/ohc.features: keep them in step.
 */
/dts-v1/;

#include "ea3.dtsi"
#include "ea-wifi.dtsi"
#include "ea-switch.dtsi"
#include "ea-audio-dsp.dtsi"
#include "ea-gpio-names.dtsi"

/ {
	model = "Control4 EA-3 v1";
	compatible = "control4,ea3-v1", "intel,ce5300";
};

/*
 * What sits behind the IO microcontroller (the node is in ea.dtsi). This is the
 * only copy: the driver publishes it at /sys/class/ohc/iomcu and iod reads it
 * from there, so board.env carries no counts.
 */
&io_mcu {
	control4,relays = <1>;
	control4,contacts = <1>;
	control4,ir-outputs = <6>;	/* rear jacks */
	control4,ir-blaster;		/* internal front emitter */
	control4,ir-receiver;		/* front learner */
	control4,uarts = <3>;		/* combo jacks in serial mode */
};
