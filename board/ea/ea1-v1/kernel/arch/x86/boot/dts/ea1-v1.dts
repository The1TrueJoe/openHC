// SPDX-License-Identifier: GPL-2.0
/*
 * Control4 EA-1 v1: Wi-Fi, no switch, no DSP.
 * Lives with the board; the .dtsi files are shared, in
 * board/ea/common/kernel/arch/x86/boot/dts/. The includes mirror
 * board/ea/ea1-v1/ohc.features: keep them in step.
 */
/dts-v1/;

#include "ea.dtsi"
#include "ea-wifi.dtsi"
#include "ea-gpio-names.dtsi"

/ {
	model = "Control4 EA-1 v1";
	compatible = "control4,ea1-v1", "intel,ce5300";
};
