// SPDX-License-Identifier: GPL-2.0
/* Control4 EA-5 v2. Includes mirror ohc.features. */
/dts-v1/;

#include "ea5.dtsi"
#include "ea-gpio-names.dtsi"

/ {
	model = "Control4 EA-5 v2";
	compatible = "control4,ea5-v2", "intel,ce5300";
};
