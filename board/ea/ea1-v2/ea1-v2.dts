// SPDX-License-Identifier: GPL-2.0
/*
 * Control4 EA-1 v2: Wi-Fi, no switch, no DSP.
 * Lives with the board; the .dtsi files are shared, in
 * board/ea/common/kernel/arch/x86/boot/dts/. The includes mirror
 * board/ea/ea1-v2/ohc.features: keep them in step.
 */
/dts-v1/;

#include "ea.dtsi"
#include "ea-wifi.dtsi"
#include "ea-gpio-names.dtsi"

/ {
	model = "Control4 EA-1 v2";
	compatible = "control4,ea1-v2", "intel,ce5300";
};

/*
 * What sits behind the IO microcontroller (the node is in ea.dtsi). The same
 * counts as board.env's OHC_RELAYS, OHC_CONTACTS, OHC_IR_* and OHC_IO_UARTS,
 * which iod still reads: keep them in step.
 */
&io_mcu {
	control4,ir-outputs = <4>;	/* rear jacks */
	control4,ir-blaster;		/* internal front emitter */
	control4,ir-receiver;		/* front learner */
	control4,uarts = <2>;		/* combo jacks in serial mode */
};
