// SPDX-License-Identifier: GPL-2.0
/* Control4 EA-1 v2. Includes mirror ohc.features. */
/dts-v1/;

#include "ea1.dtsi"
#include "ea-wifi.dtsi"
#include "ea-gpio-names.dtsi"

/ {
	model = "Control4 EA-1 v2";
	compatible = "control4,ea1-v2", "intel,ce5300";
};
