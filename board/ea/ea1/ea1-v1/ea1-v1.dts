// SPDX-License-Identifier: GPL-2.0
/* Control4 EA-1 v1. Includes mirror ohc.features. */
/dts-v1/;

#include "ea1.dtsi"
#include "ea-gbe-phy.dtsi"
#include "ea-wifi.dtsi"
#include "ea-gpio-names.dtsi"

/ {
	model = "Control4 EA-1 v1";
	compatible = "control4,ea1-v1", "intel,ce5300";
	/* What the board-ID straps read here (stock /proc/c4board). */
	control4,board-type = <1>;
	control4,board-revisions = <5>;
};
